## meta-webos-raspberrypi/conf/machine/raspberrypi5.conf
```bitbake
# Copyright (c) 2025 Minjae Kim

# This came from meta-raspberrypi for cumstomizing in webOS.
# It should be modified when meta-raspberrypi is updated.
require ${META_RASPBERRYPI_LAYER}/conf/machine/raspberrypi5.conf

require conf/machine/include/webos-rpi.inc
```
